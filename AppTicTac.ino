
int n=3;
int numbers[3][3];
int posX[3];
int boxSize=64;
int space=5;
int start=19;
bool player=0;
bool gameover=0;
bool irq = false;

int frames=2;
int animation_width=64;
int animation_height=64;
const unsigned short PROGMEM tic[][4096]= {{0xFFFF,0xFFFF,0xFFFF,0xFFFF,0xFFFF,0xFFFF,0xFFFF,0xFFFF,0xFFFF,0xFFFF,0xFFDF,0xFFFF,0xFFFF,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0xFFFF,0xFFFF},
{0xFFFF,0xFFFF,0xFFFF,0xFFFF,0xFFFF,0xFFFF,0xFFFF,0xFFFF,0xFFFF,0xFFFF,0xFFFF,0xFFFF,0xFFFF,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0xFFFF,0xFFFF},
};



void appTicTac() {
  prepareTicTac();
  jouerTicTac();
}

void prepareTicTac() {
   ttgo->tft->fillScreen(TFT_WHITE);
   //ttgo->tft->setFreeFont(&DSEG7_Classic_Regular_40);
   ttgo->tft->setTextColor(TFT_BLACK);
   
   for(int i=0;i<n;i++) posX[i]=(start+(i*boxSize)+(space*i));

   ttgo->tft->fillRect(posX[1]-5,posX[0],4,206,TFT_BLACK);
   ttgo->tft->fillRect(posX[2]-5,posX[0],4,206,TFT_BLACK);

   ttgo->tft->fillRect(posX[0],posX[1]-5,206,4,TFT_BLACK);
   ttgo->tft->fillRect(posX[0],posX[2]-5,206,4,TFT_BLACK);

   for(int i=0;i<n;i++)
     for(int j=0;j<n;j++){
       //ttgo->tft->fillRect(posX[i],posX[j],boxSize,boxSize,TFT_BLUE);
       numbers[j][i]=0;
     }
}


void jouerTicTac() {
  int16_t x, y;
  int coup=9;
  
    while(coup!=0){
      if (ttgo->getTouch(x, y)) {
        for(int i=0;i<n;i++)
          for(int j=0;j<n;j++){
             if(x>posX[j] && x<posX[j]+boxSize && y>posX[i] && y<posX[i]+boxSize ){
                if(numbers[j][i]==0){ 
                  ttgo->tft->pushImage(posX[j],posX[i],boxSize,boxSize,tic[player]);
                   coup = coup - 1;
                   if(player==0) numbers[j][i]=1;
                   if(player==1) numbers[j][i]=2;
                   player=!player;
                   x=0;
                   y=0;
                }
             }
          }
      }
      check();
    }
    delay(3000);
}


void check() {
   //ttgo->tft->drawCentreString( "Je check", 100, 5, 4); 
   for(int i=0;i<3;i++){ ///horizontsl test{
     if(numbers[i][0]>0 && numbers[i][1]>0 && numbers[i][2]>0 ){
       if(numbers[i][0]== 1 && numbers[i][1]==1 && numbers[i][2]==1 ){
         gameover=1;
         ttgo->tft->fillRect(posX[i]+31,9, 6,220,TFT_RED);
       }
       if(numbers[i][0]== 2 && numbers[i][1]==2 && numbers[i][2]==2 ){
         gameover=1;
         ttgo->tft->fillRect(posX[i]+31,9, 6,220,TFT_RED);
       }
     }
   }

   for(int i=0;i<3;i++){ ///horizontsl test{
      if(numbers[0][i]>0 && numbers[1][i]>0 && numbers[2][i]>0 ){
         if(numbers[0][i]== 1 && numbers[1][i]==1 && numbers[2][i]==1 ){
            gameover=1;
            ttgo->tft->fillRect(9,posX[i]+31, 220,6,TFT_RED);
         }
         if(numbers[0][i]== 2 && numbers[1][i]==2 && numbers[2][i]==2 ){
            gameover=1;
            ttgo->tft->fillRect(9,posX[i]+31, 220,6,TFT_RED);
         }
      }
   }

   if(numbers[0][0]>0 && numbers[1][1]>0 && numbers[2][2]>0){
      if(numbers[0][0]==1 && numbers[1][1]==1 && numbers[2][2]==1){
        gameover=1;
        ttgo->tft->drawLine(13,14,219,220,TFT_RED);
        ttgo->tft->drawLine(14,14,220,220,TFT_RED);
        ttgo->tft->drawLine(15,14,221,220,TFT_RED);
      }

      if(numbers[0][0]==2 && numbers[1][1]==2 && numbers[2][2]==2){
        gameover=1;
        ttgo->tft->drawLine(13,14,219,220,TFT_RED);
        ttgo->tft->drawLine(14,14,220,220,TFT_RED);
        ttgo->tft->drawLine(15,14,221,220,TFT_RED);
      }
   }

   if(numbers[0][2]>0 && numbers[1][1]>0 && numbers[2][0]>0){
      if(numbers[0][2]==1 && numbers[1][1]==1 && numbers[2][0]==1){
        gameover=1;
        ttgo->tft->drawLine(14,220,220,14,TFT_RED);
        ttgo->tft->drawLine(14,219,220,13,TFT_RED);
        ttgo->tft->drawLine(14,221,220,15,TFT_RED);
      }
      if(numbers[0][2]==2 && numbers[1][1]==2 && numbers[2][0]==2){
        gameover=1;
        ttgo->tft->drawLine(14,220,220,14,TFT_RED);
        ttgo->tft->drawLine(14,219,220,13,TFT_RED);
        ttgo->tft->drawLine(14,221,220,15,TFT_RED);
      }
   }
}
